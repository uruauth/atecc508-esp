## Kconfig.projbuild
```kconfig
menu "ATECC508A"

    config ATECC508A_I2C_MASTER_SDA
        int "SDA GPIO Num"
        default 21
        help
            GPIO number for I2C Master data line.

    config ATECC508A_I2C_MASTER_SCL
        int "SCL GPIO Num"
        default 22
        help
            GPIO number for I2C Master clock line.

    config ATECC508A_I2C_MASTER_PORT_NUM
        int "Port Number"
        default 0
        help
            Port number for I2C Master device.

    config ATECC508A_I2C_MASTER_FREQUENCY
        int "Master Frequency"
        default 100000
        help
            I2C Speed of Master device.

endmenu
```
